## components/rf433/Kconfig.projbuild
```kconfig
menu "RF433 Reciever"
    config RF433_RECEIVER_GPIO
        int "RF433 Reciever GPIO number"
        range 0 39
        default 14
        help
            GPIO number (IOxx) connected to 315/433-MHz RF receiver module.

    config RF433_PROTOCOL_EV1527
        bool "Enable EV1527 chip protocol"
        default y
        help
            Support devices based on EV1527, RT1527, FP1527, HS1527, etc chips.
endmenu
```

## main/Kconfig.projbuild
```kconfig
menu "Application"
    config RF_RECEIVER_GPIO
        int "RF Receiver GPIO number"
        range 0 39
        default 14
        help
            GPIO number (IOxx) connected to 315/433-MHz RF receiver module.
endmenu
```

## sdkconfig.defaults
```kconfig
CONFIG_ESPTOOLPY_FLASHMODE_DOUT=y
CONFIG_ESPTOOLPY_FLASHSIZE_4MB=y

CONFIG_COMPILER_OPTIMIZATION_SIZE=y

CONFIG_FREERTOS_ENABLE_BACKWARD_COMPATIBILITY=y
```
